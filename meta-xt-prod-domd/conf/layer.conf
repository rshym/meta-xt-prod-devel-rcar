## meta-xt-prod-domd/conf/layer.conf
```bitbake
# We have a conf and classes directory, add to BBPATH
BBPATH .= ":${LAYERDIR}"

# We have a packages directory, add to BBFILES
BBFILES += "${LAYERDIR}/recipes-*/*/*.bb \
            ${LAYERDIR}/recipes-*/*/*.bbappend"

BBFILE_COLLECTIONS += "xt-prod-domd"
BBFILE_PATTERN_xt-prod-domd := "^${LAYERDIR}/"
BBFILE_PRIORITY_xt-prod-domd = "12"

LAYERSERIES_COMPAT_xt-prod-domd = "kirkstone"
```

## meta-xt-prod-domx/conf/layer.conf
```bitbake
# We have a conf and classes directory, add to BBPATH
BBPATH .= ":${LAYERDIR}"

# We have a packages directory, add to BBFILES
BBFILES += "${LAYERDIR}/recipes-*/*/*.bb \
            ${LAYERDIR}/recipes-*/*/*.bbappend"

BBFILE_COLLECTIONS += "xt-prod-domx"
BBFILE_PATTERN_xt-prod-domx := "^${LAYERDIR}/"
BBFILE_PRIORITY_xt-prod-domx = "12"

LAYERSERIES_COMPAT_xt-prod-domx = "kirkstone"
```
